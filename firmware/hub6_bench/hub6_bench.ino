// hub6_bench: drive six 1.28 inch round LCDs (GC9A01, Waveshare 1.28inch LCD Module) from one
// XIAO ESP32-S3 through a 74HC138. Built for the hub6_one board (hardware/hub6_one) by default;
// with -DHUB6_BREADBOARD, for the breadboard that checked six displays on one SPI bus before
// ordering (wired as hardware/hub6/README.md).
//
//   hub6_one:   DIN D5, CLK D4, DC D3, RST D2, BL D1; the 74HC138's A0, A1, A2 on D10, D9, D8
//   breadboard: DIN D0, CLK D1, DC D3, RST D4, BL D5; the 74HC138's A0, A1, A2 on D7, D8, D9
//   All six displays share DIN, CLK, DC, RST and BL; the 74HC138's output Yn is the CS of one display.
//
// Serial (USB, 115200):
//   i        identity (the default): each display shows its name, its 74HC138 address and a colour, and stays
//   e        earth: each display shows its part of the globe (earth_faces.h), and stays
//   b        benchmark: full-screen fills on all six in turn, frames/s printed
//   c [MHz]  microSD of the Sense expansion board: type, size, the root's listing; reads only
//   cw [MHz] the same, then writes /dodeca_test.bin (115200 bytes), reads it back, removes it, and times it
//   w        wifi: the AP, channel, rssi and address, or the channel the radio is on without one (wifi_status.h)
//   f <MHz>  SPI clock for the next boot (80, 40, 27, 20, 16, 10), saved, then restarts
//   r <d>    send display d (0 = P1 .. 5 = BASE) its init sequence again and redraw it, the others untouched
//
// ESP-NOW: the same commands, from exp-cubic-earth's espnow_bridge on the host. At boot (after the
// identity screen) the XIAO joins the first access point of secrets.h it can (WIFI_APS, the same
// list as the cubic earth's, see secrets.h.example) and ESP-NOW rides on that AP's channel, as the
// bridge does. A line sent to this XIAO's MAC ("!AA:BB:.. e" to the bridge) or broadcast with
// "@dodeca " in front ("@dodeca e") is a command (espnow_cmd.h); the cubic earth's "#.." lines are
// not. What the command prints goes to the USB serial and back to the sender, line by line.
//
// LovyanGFX (in M5GFX) drives the panel. Its CS is not used (pin_cs = -1): this sketch selects a
// display by setting the 74HC138's address, and only between transfers, while SCK is idle (the
// decoder's outputs can glitch while the address changes). Address 7 (Y7, not connected)
// selects none.
#include <M5GFX.h>
#include <lgfx/v1/panel/Panel_GC9A01.hpp>
#include <Preferences.h>
#include <SD.h>
#include <SPI.h>
#include <WiFi.h>
#include <esp_now.h>
#include <esp_wifi.h>
#include <stdarg.h>

#include "espnow_cmd.h"
#include "wifi_status.h"
#if __has_include("secrets.h")
#include "secrets.h"  // WIFI_APS (secrets.h.example; not in git)
#endif
#ifndef ESPNOW_CHANNEL
#define ESPNOW_CHANNEL 1  // with no AP joined, as espnow_bridge
#endif

#include "earth_faces.h"  // generated by make_earth_faces.py (not in git): P1..P5, BASE

constexpr int NUM_DISPLAYS = 6;
// display d (plate 1..5, then the base) -> the 74HC138 address (Yn) that selects it
#ifdef HUB6_BREADBOARD
constexpr int PIN_DIN = D0, PIN_CLK = D1, PIN_DC = D3, PIN_RST = D4, PIN_BL = D5;
constexpr int PIN_A0 = D7, PIN_A1 = D8, PIN_A2 = D9;
constexpr uint8_t ADDRESS[NUM_DISPLAYS] = {0, 1, 2, 3, 5, 4};  // hub6 README
#else
constexpr int PIN_DIN = D5, PIN_CLK = D4, PIN_DC = D3, PIN_RST = D2, PIN_BL = D1;
constexpr int PIN_A0 = D10, PIN_A1 = D9, PIN_A2 = D8;
constexpr uint8_t ADDRESS[NUM_DISPLAYS] = {2, 1, 0, 5, 3, 4};  // hub6_one make.py CS_OUTPUT
#endif
constexpr uint8_t NONE = 7;
const char *const NAME[NUM_DISPLAYS] = {"P1", "P2", "P3", "P4", "P5", "BASE"};
const uint16_t COLOUR[NUM_DISPLAYS] = {TFT_RED, TFT_GREEN, TFT_BLUE, TFT_YELLOW, TFT_MAGENTA, TFT_CYAN};
const char *const COLOUR_NAME[NUM_DISPLAYS] = {"RED", "GREEN", "BLUE", "YELLOW", "MAGENTA", "CYAN"};
const uint32_t ALLOWED_MHZ[] = {80, 40, 27, 20, 16, 10};
// Mounted in the cup, the displays read upside down at the panel's own rotation: turn all six 180 degrees.
constexpr uint8_t ROTATION = 2;

// The GC9A01 panel, with a way to send its init sequence again without initialising the SPI bus
// again: lcd.init() does both, for the first display; the other five get only the commands.
struct Panel_Hub6 : public lgfx::Panel_GC9A01 {
  void sendInitCommands() {
    startWrite(true);
    for (uint8_t i = 0; auto cmds = getInitCommands(i); i++) command_list(cmds);
    endWrite();
    setColorDepth(getWriteDepth());  // COLMOD and MADCTL, as lcd.init() sends them
    setInvert(getInvert());          // INVON, as lcd.init() sends it (the panel's cfg.invert is true)
  }
  // LovyanGFX remembers the last address window it sent (CASET, RASET) and skips them when the next
  // draw uses the same one. That holds for one panel, not for six behind one object: a full-screen
  // draw on the next display would go into whatever window that display last had. Forget it on
  // every switch, so the window is always sent.
  void forgetWindow() {
    _xsxe = ~0u;
    _ysye = ~0u;
  }
};

class LGFX : public lgfx::LGFX_Device {
 public:
  Panel_Hub6 panel;
  lgfx::Bus_SPI bus;

  void configure(uint32_t hz) {
    auto b = bus.config();
    b.spi_host = SPI2_HOST;
    b.spi_mode = 0;
    b.freq_write = hz;
    b.freq_read = 8000000;
    b.spi_3wire = true;
    b.use_lock = true;
    b.dma_channel = SPI_DMA_CH_AUTO;
    b.pin_sclk = PIN_CLK;
    b.pin_mosi = PIN_DIN;
    b.pin_miso = -1;
    b.pin_dc = PIN_DC;
    bus.config(b);
    panel.setBus(&bus);
    auto p = panel.config();
    p.pin_cs = -1;   // the 74HC138 selects
    p.pin_rst = -1;  // shared: reset once, by hand, for all six
    p.pin_busy = -1;
    p.panel_width = p.memory_width = 240;
    p.panel_height = p.memory_height = 240;
    p.offset_rotation = ROTATION;  // every MADCTL sent (lcd.init() and sendInitCommands()) includes it
    p.readable = false;
    p.invert = true;
    p.rgb_order = false;
    p.bus_shared = false;
    panel.config(p);
    setPanel(&panel);
  }
};

LGFX lcd;
Preferences prefs;
uint32_t spi_hz;
enum Mode { EARTH, IDENTITY, BENCHMARK } mode = IDENTITY;

// ---- ESP-NOW ----
// The receive callback runs in the Wi-Fi task: it only queues the line; loop() runs it.
struct EspnowLine {
  uint8_t from[6];
  char cmd[32];
};
QueueHandle_t espnowQueue;
uint8_t myMac[6];
bool replyOn = false;  // while a command from ESP-NOW runs, say() also sends to replyMac
uint8_t replyMac[6];

void onEspnowRecv(const esp_now_recv_info_t *info, const uint8_t *data, int n) {
  EspnowLine l;
  bool toMe = memcmp(info->des_addr, myMac, 6) == 0;
  if (espnowCommand(data, n, toMe, l.cmd, sizeof l.cmd) < 0) return;
  memcpy(l.from, info->src_addr, 6);
  xQueueSend(espnowQueue, &l, 0);
}

// Print a line to the USB serial, and to the sender of the command being run if it came by ESP-NOW.
void say(const char *fmt, ...) {
  char text[200];
  va_list ap;
  va_start(ap, fmt);
  vsnprintf(text, sizeof text, fmt, ap);
  va_end(ap);
  Serial.println(text);
  if (!replyOn) return;
  if (!esp_now_is_peer_exist(replyMac)) {
    esp_now_peer_info_t peer = {};
    memcpy(peer.peer_addr, replyMac, 6);
    peer.channel = 0;  // the current channel
    esp_now_add_peer(&peer);
  }
  esp_now_send(replyMac, (const uint8_t *)text, strlen(text));
}

// espnow_bridge's joinWiFi: the APs of secrets.h that a scan sees, in their order; if it sees none, all of them.
bool joinWiFi() {
#ifdef WIFI_APS
  struct Ap { const char *ssid, *pass; };
  static const Ap aps[] = WIFI_APS;
  const int nAps = sizeof aps / sizeof aps[0];
  int n = WiFi.scanNetworks();
  bool anySeen = false;
  for (int a = 0; a < nAps; a++)
    for (int i = 0; i < n; i++) anySeen = anySeen || WiFi.SSID(i) == aps[a].ssid;
  for (int a = 0; a < nAps; a++) {
    bool seen = false;
    int rssi = 0;
    for (int i = 0; i < n; i++)
      if (WiFi.SSID(i) == aps[a].ssid) seen = true, rssi = WiFi.RSSI(i);
    if (anySeen && !seen) continue;
    Serial.printf("wifi: joining %s (rssi %d in the scan; %d APs seen)\n", aps[a].ssid, seen ? rssi : 0, n);
    WiFi.begin(aps[a].ssid, aps[a].pass);
    uint32_t t0 = millis();
    // 15 s: pi5-w-1 handed out the address 3 s after the handshake, and 8 s (espnow_bridge) gave up just before
    while (WiFi.status() != WL_CONNECTED && millis() - t0 < 15000) delay(100);
    if (WiFi.status() == WL_CONNECTED) {
      WiFi.scanDelete();
      Serial.printf("wifi: %s, channel %d\n", aps[a].ssid, (int)WiFi.channel());
      return true;
    }
    WiFi.disconnect();
  }
  WiFi.scanDelete();
  Serial.println("wifi: no AP from secrets.h joined");
#else
  Serial.println("wifi: no secrets.h (see secrets.h.example)");
#endif
  return false;
}

void setupEspnow() {
  espnowQueue = xQueueCreate(8, sizeof(EspnowLine));
  WiFi.mode(WIFI_STA);
  WiFi.setSleep(false);  // fewer lost packets (espnow_bridge)
  WiFi.onEvent([](WiFiEvent_t, WiFiEventInfo_t info) {
    Serial.printf("wifi: disconnected, reason %u\n", info.wifi_sta_disconnected.reason);
  }, ARDUINO_EVENT_WIFI_STA_DISCONNECTED);
  esp_wifi_get_mac(WIFI_IF_STA, myMac);
  if (!joinWiFi()) esp_wifi_set_channel(ESPNOW_CHANNEL, WIFI_SECOND_CHAN_NONE);
  if (esp_now_init() != ESP_OK) {
    Serial.println("espnow: init failed");
    return;
  }
  esp_now_register_recv_cb(onEspnowRecv);
  uint8_t ch = 0;
  wifi_second_chan_t ch2;
  esp_wifi_get_channel(&ch, &ch2);
  Serial.printf("espnow: %02X:%02X:%02X:%02X:%02X:%02X, channel %d (%s); commands to this MAC or after \"%s\"\n", myMac[0], myMac[1],
                myMac[2], myMac[3], myMac[4], myMac[5], ch, WiFi.status() == WL_CONNECTED ? "the AP's" : "ESPNOW_CHANNEL", ESPNOW_PREFIX);
}

void select(uint8_t address) {
  lcd.waitDMA();  // never change the address while a transfer runs
  digitalWrite(PIN_A0, address & 1);
  digitalWrite(PIN_A1, (address >> 1) & 1);
  digitalWrite(PIN_A2, (address >> 2) & 1);
  lcd.panel.forgetWindow();
}

// ---- microSD (XIAO ESP32-S3 Sense expansion board) ----
// The card's SCK, MISO and MOSI are D8, D9 and D10, which this board uses as the 74HC138's A2, A1 and A0;
// its CS is GPIO21 (the expansion board's R12). So the pins are the card's only while it is being read or
// written: mount, work, unmount, and give them back as address outputs. While the card talks, the address
// lines wiggle and some display's CS may go low, but the displays' own CLK (D4) and DIN (D5) are idle then,
// so nothing is clocked into them. The card has its own bus (SPI3); the displays use SPI2.
constexpr int SD_CS = 21;
SPIClass sdSpi(HSPI);

void cardGivePinsBack() {
  sdSpi.end();
  for (int pin : {PIN_A0, PIN_A1, PIN_A2}) pinMode(pin, OUTPUT);
  select(NONE);
}

void cardTest(long mhz, bool write) {
  if (mhz <= 0) mhz = 10;
  lcd.waitDMA();
  sdSpi.begin(PIN_A2, PIN_A1, PIN_A0, SD_CS);  // SCK D8, MISO D9, MOSI D10
  if (!SD.begin(SD_CS, sdSpi, mhz * 1000000, "/sd", 5)) {
    cardGivePinsBack();
    say("card: mount failed (no card, or no expansion board)");
    return;
  }
  static const char *types[] = {"none", "MMC", "SD", "SDHC", "unknown"};
  uint8_t t = SD.cardType();
  say("card: %s, %llu MB, used %llu / %llu MB, SPI %ld MHz", types[t < 4 ? t : 4], SD.cardSize() >> 20, SD.usedBytes() >> 20,
      SD.totalBytes() >> 20, mhz);
  if (!write) {  // read only: the root's listing, nothing written (the card may be someone else's)
    File root = SD.open("/");
    int n = 0;
    for (File e = root.openNextFile(); e && n < 8; e = root.openNextFile(), n++)
      say("card: /%s%s %u", e.name(), e.isDirectory() ? "/" : "", (unsigned)e.size());
    root.close();
    SD.end();
    cardGivePinsBack();
    return;
  }
  const size_t N = 240 * 240 * 2, CH = 4096;  // one display's face
  static uint8_t buf[CH];
  File f = SD.open("/dodeca_test.bin", FILE_WRITE);
  if (!f) {
    SD.end();
    cardGivePinsBack();
    say("card: open for write failed");
    return;
  }
  uint32_t t0 = millis();
  for (size_t i = 0; i < N; i += CH) {
    size_t n = N - i < CH ? N - i : CH;
    for (size_t j = 0; j < n; j++) buf[j] = (uint8_t)((i + j) * 7 + ((i + j) >> 9));
    f.write(buf, n);
  }
  f.close();
  uint32_t t1 = millis();
  f = SD.open("/dodeca_test.bin");
  size_t bad = 0, got = 0;
  for (size_t i = 0; i < N; i += CH) {
    size_t r = f.read(buf, N - i < CH ? N - i : CH);
    got += r;
    for (size_t j = 0; j < r; j++) bad += buf[j] != (uint8_t)((i + j) * 7 + ((i + j) >> 9));
  }
  f.close();
  uint32_t t2 = millis();
  SD.remove("/dodeca_test.bin");
  SD.end();
  cardGivePinsBack();
  say("card: wrote %u bytes in %lu ms, read %u in %lu ms, %u bad bytes%s", (unsigned)N, (unsigned long)(t1 - t0), (unsigned)got,
      (unsigned long)(t2 - t1), (unsigned)bad, got == N ? "" : " (short read)");
}

void drawIdentity(int d) {
  select(ADDRESS[d]);
  lcd.startWrite();
  lcd.fillScreen(COLOUR[d]);
  lcd.setTextColor(TFT_BLACK, COLOUR[d]);
  lcd.setTextDatum(middle_center);
  lcd.setFont(&fonts::Font4);
  lcd.setTextSize(2);
  lcd.drawString(NAME[d], 120, 90);
  lcd.setTextSize(1);
  char line[32];
  snprintf(line, sizeof line, "address %u", ADDRESS[d]);
  lcd.drawString(line, 120, 150);
  lcd.drawString(COLOUR_NAME[d], 120, 180);
  lcd.endWrite();
  select(NONE);
}

void showIdentity() {
  for (int d = 0; d < NUM_DISPLAYS; d++) drawIdentity(d);
  say("identity: P1 RED, P2 GREEN, P3 BLUE, P4 YELLOW, P5 MAGENTA, BASE CYAN");
}

// The faces live in flash, which the SPI DMA cannot read: copy them a line at a time into RAM and
// send each line from there (plain RGB565 values, so swap = true in LovyanGFX's terms).
void drawEarth(int d) {
  static uint16_t line[240];
  {
    select(ADDRESS[d]);
    lcd.startWrite();
    lcd.setAddrWindow(0, 0, 240, 240);
    for (int y = 0; y < 240; y++) {
      memcpy(line, &EARTH_FACES[d][y * 240], sizeof line);
      lcd.writePixels(line, 240, true);
    }
    lcd.endWrite();
    select(NONE);
  }
}

void showEarth() {
  for (int d = 0; d < NUM_DISPLAYS; d++) drawEarth(d);
  say("earth");
}

void setup() {
  Serial.begin(115200);
  for (int pin : {PIN_A0, PIN_A1, PIN_A2, PIN_RST, PIN_BL}) pinMode(pin, OUTPUT);
  select(NONE);
  digitalWrite(PIN_BL, LOW);

  prefs.begin("hub6bench", false);
  spi_hz = prefs.getUInt("hz", 20000000);  // six displays on the bench leads were steady up to 20 MHz (README)
  lcd.configure(spi_hz);

  // one reset for all six (RST is shared)
  digitalWrite(PIN_RST, HIGH);
  delay(10);
  digitalWrite(PIN_RST, LOW);
  delay(20);
  digitalWrite(PIN_RST, HIGH);
  delay(150);

  // lcd.init() sets up the SPI bus and sends the init sequence in one go. With a display selected,
  // that display came up as noise after every power-on (the pins settling while it listened, it
  // seems); a second init sequence fixed it. So set up the bus with none selected, then give all six
  // the same init sequence.
  lcd.init();
  for (int d = 0; d < NUM_DISPLAYS; d++) {
    select(ADDRESS[d]);
    lcd.panel.sendInitCommands();  // sleep out (120ms) and display on are in the sequence
    lcd.startWrite();
    lcd.clear();
    lcd.endWrite();
    select(NONE);
  }
  digitalWrite(PIN_BL, HIGH);
  delay(500);  // the USB serial port comes up after a moment
  Serial.printf("hub6_bench: %d displays, SPI %.2f MHz (asked for), e/i/b/f <MHz>/r <d>\n", NUM_DISPLAYS, spi_hz / 1e6);
  showIdentity();
  setupEspnow();  // after the screens: joining an AP takes a few seconds
}

void handleLine(const char *buf);

void handleSerial() {
  static char buf[32];
  static int len = 0;
  while (Serial.available()) {
    char c = Serial.read();
    if (c != '\n' && c != '\r') {
      if (len < (int)sizeof buf - 1) buf[len++] = c;
      continue;
    }
    buf[len] = 0;
    len = 0;
    handleLine(buf);
  }
}

void handleLine(const char *buf) {
  {
    if (buf[0] == 'e') {
      mode = EARTH;
      showEarth();
    } else if (buf[0] == 'i') {
      mode = IDENTITY;
      showIdentity();
    } else if (buf[0] == 'c') {
      bool w = buf[1] == 'w';  // "cw": also write and read back a test file
      cardTest(atoi(buf + (w ? 2 : 1)), w);
    } else if (buf[0] == 'w') {
      uint8_t ch = 0;
      wifi_second_chan_t ch2;
      esp_wifi_get_channel(&ch, &ch2);
      bool joined = WiFi.status() == WL_CONNECTED;
      char line[120];
      wifiStatusLine(line, sizeof line, joined, joined ? WiFi.SSID().c_str() : "", ch, ESPNOW_CHANNEL,
                     joined ? (int)WiFi.RSSI() : 0, WiFi.localIP().toString().c_str(), millis() / 1000);
      say("%s", line);
    } else if (buf[0] == 'b') {
      mode = BENCHMARK;
      say("benchmark");
    } else if (buf[0] == 'r') {
      int d = atoi(buf + 1);
      if (d < 0 || d >= NUM_DISPLAYS) {
        say("r: 0 (P1) .. 5 (BASE)");
        return;
      }
      select(ADDRESS[d]);
      lcd.panel.sendInitCommands();
      lcd.startWrite();
      lcd.clear();
      lcd.endWrite();
      select(NONE);
      if (mode == IDENTITY) drawIdentity(d); else drawEarth(d);
      say("re-initialised %s (address %u)", NAME[d], ADDRESS[d]);
    } else if (buf[0] == 'f') {
      uint32_t mhz = strtoul(buf + 1, nullptr, 10);
      bool ok = false;
      for (uint32_t m : ALLOWED_MHZ) ok |= (m == mhz);
      if (!ok) {
        say("f: one of 80, 40, 27, 20, 16, 10");
        return;
      }
      prefs.putUInt("hz", mhz == 27 ? 26666667 : mhz * 1000000);
      say("SPI %lu MHz from the next boot; restarting", (unsigned long)mhz);
      delay(100);
      ESP.restart();
    }
  }
}

void handleEspnow() {
  EspnowLine l;
  while (espnowQueue && xQueueReceive(espnowQueue, &l, 0) == pdTRUE) {
    memcpy(replyMac, l.from, 6);
    replyOn = true;
    Serial.printf("espnow from %02X:%02X:%02X:%02X:%02X:%02X: %s\n", l.from[0], l.from[1], l.from[2], l.from[3], l.from[4], l.from[5], l.cmd);
    handleLine(l.cmd);
    replyOn = false;
  }
}

void loop() {
  handleSerial();
  handleEspnow();
  if (mode != BENCHMARK) {
    delay(20);
    return;
  }
  // One frame: a full-screen fill on each of the six in turn, alternating between the display's
  // colour and black, with its name on top (a name on the wrong display means a select went wrong).
  static uint32_t frames = 0, t0 = millis();
  bool on = frames & 1;
  for (int d = 0; d < NUM_DISPLAYS; d++) {
    select(ADDRESS[d]);
    lcd.startWrite();
    uint16_t bg = on ? COLOUR[d] : TFT_BLACK;
    lcd.fillScreen(bg);
    lcd.setTextColor(on ? TFT_BLACK : COLOUR[d], bg);
    lcd.setTextDatum(middle_center);
    lcd.setFont(&fonts::Font4);
    lcd.setTextSize(2);
    lcd.drawString(NAME[d], 120, 120);
    lcd.endWrite();
    select(NONE);
  }
  frames++;
  uint32_t dt = millis() - t0;
  if (dt >= 2000) {
    Serial.printf("%.1f frames/s (6 full screens each), SPI %.2f MHz\n", frames * 1000.0 / dt, spi_hz / 1e6);
    frames = 0;
    t0 = millis();
  }
}
